// This is a custom linker config file to spoof the amount of memory on the
// device so we can write more unit tests.
-cmsp430
-QCODE_I=CODE_ID
-Z(DATA)DATA16_I,DATA16_Z,DATA16_N,TLS16_I,DATA16_HEAP+_DATA16_HEAP_SIZE=1C00-3FFF
-Z(DATA)CODE_I
-Z(DATA)CSTACK+_STACK_SIZE#
-Z(CONST)DATA16_C,DATA16_ID,TLS16_ID,DIFUNCT,CHECKSUM=C200-FF7F
-Z(CODE)CSTART,ISR_CODE,CODE_ID=C200-FF7F
-P(CODE)CODE=C200-FF7F,10000-FFFFF
-Z(CODE)INTVEC=FF80-FFFF
-Z(CODE)RESET=FFFE-FFFF
